## conf/distro/poky-papercut.conf
```bitbake
require conf/distro/poky.conf

DISTRO = "poky-papercut"
DISTROOVERRIDES = "poky"

PREFERRED_VERSION_glib-2.0 ?= "2.39.0+git%"
SRCREV_pn-glib-2.0 = "${AUTOREV}"

PREFERRED_VERSION_glib-2.0-native ?= "2.39.0+git%"
SRCREV_pn-glib-2.0-native = "${AUTOREV}"

PREFERRED_VERSION_gtk+3 = "3.9.2+git%"
SRCREV_pn-gtk+3 = "${AUTOREV}"
```

## conf/layer.conf
```bitbake
# We have a conf and classes directory, add to BBPATH
BBPATH .= ":${LAYERDIR}"

# We have recipes-* directories, add to BBFILES
BBFILES += "${LAYERDIR}/recipes-*/*/*.bb \
	${LAYERDIR}/recipes-*/*/*.bbappend"

BBFILE_COLLECTIONS += "ross"
BBFILE_PATTERN_ross = "^${LAYERDIR}/"
BBFILE_PRIORITY_ross = "6"

LAYERSERIES_COMPAT_ross = "${LAYERSERIES_COMPAT_core}"
```
